## CMakeLists.txt
```
cmake_minimum_required(VERSION 3.20.0)

find_package(Zephyr REQUIRED HINTS $ENV{ZEPHYR_BASE})
project(thingplus_coap_light_switch)

target_sources(app PRIVATE src/main.c)
```

## Kconfig
```
mainmenu "Thing Plus Matter - CoAP Light Switch"

config LIGHT_SWITCH_COAP_URI
	string "CoAP resource URI path"
	default "matter-light"
	help
	  Button press sends a CoAP PUT to this resource on the peer.

config LIGHT_SWITCH_PEER_ADDR
	string "CoAP peer IPv6 address"
	default "ff03::1"
	help
	  Destination of the CoAP request. Default is the realm-local
	  all-nodes multicast address so every node in the Thread mesh
	  (including the Border Router host) receives it. Set a unicast
	  mesh-local address of the bridge host to avoid multicast.

config LIGHT_SWITCH_DEBOUNCE_MS
	int "Button debounce / rate-limit (ms)"
	default 250
	help
	  Ignore further edges for this long after a press. Arcade
	  microswitches bounce heavily, and this also rate-limits
	  CoAP transmissions.

source "Kconfig.zephyr"
```

## prj.conf
```kconfig
# GPIO (arcade button + status LED)
CONFIG_GPIO=y

# Networking / OpenThread
CONFIG_NETWORKING=y
CONFIG_NET_IPV6=y
CONFIG_NET_UDP=y
CONFIG_NET_IPV4=n
CONFIG_NET_TCP=n
CONFIG_IEEE802154=y
CONFIG_NET_L2_OPENTHREAD=y

# Thread는 셸에서 dataset을 넣어 기존 네트워크에 조인한다.
# (부팅 시 저장된 dataset이 있으면 main()이 자동으로 재시작)
CONFIG_OPENTHREAD_MANUAL_START=y

# OpenThread 내장 CoAP API (otCoap*)
CONFIG_OPENTHREAD_COAP=y

# `ot ...` 셸 명령으로 네트워크 조인/디버깅
CONFIG_SHELL=y
CONFIG_OPENTHREAD_SHELL=y

# Thread 자격 증명(dataset) 영속 저장 → 재부팅 후 자동 재조인
CONFIG_SETTINGS=y
CONFIG_FLASH=y
CONFIG_FLASH_MAP=y
CONFIG_NVS=y

# Logging
CONFIG_LOG=y

# Stack sizes
CONFIG_MAIN_STACK_SIZE=4096
CONFIG_SYSTEM_WORKQUEUE_STACK_SIZE=4096
CONFIG_SHELL_STACK_SIZE=4096
```

## boards/sparkfun_thing_plus_matter_mgm240p.overlay
```dts
#include <zephyr/dt-bindings/gpio/gpio.h>

/*
 * 65mm 오락실 버튼 배선:
 *   마이크로스위치 COM → GND
 *   마이크로스위치 NO  → PB00 (내부 풀업, 누르면 LOW)
 *
 * 다른 핀을 쓰려면 아래 gpios의 포트(&gpiob)와 핀 번호(0)를 바꾸면 된다.
 */
/ {
	aliases {
		sw0 = &arcade_button;
	};

	buttons {
		compatible = "gpio-keys";

		arcade_button: button_0 {
			gpios = <&gpiob 0 (GPIO_ACTIVE_LOW | GPIO_PULL_UP)>;
			label = "65mm arcade button";
		};
	};
};
```

## src/main.c
```c
/*
 * SparkFun Thing Plus Matter (MGM240P) - CoAP over Thread Light Switch
 *
 * 65mm 오락실 버튼(PB00, active-low)이 눌리면 Thread 메시로
 * CoAP NON PUT /<CONFIG_LIGHT_SWITCH_COAP_URI> (payload: "toggle")을 전송한다.
 * Border Router 호스트의 브리지(bridge/coap_matter_bridge.py)가 이를 받아
 * chip-tool로 Matter 전등의 OnOff 클러스터를 토글한다.
 */

#include <string.h>

#include <zephyr/kernel.h>
#include <zephyr/device.h>
#include <zephyr/drivers/gpio.h>
#include <zephyr/logging/log.h>
#include <zephyr/net/openthread.h>

#include <openthread/coap.h>
#include <openthread/dataset.h>
#include <openthread/ip6.h>
#include <openthread/thread.h>

LOG_MODULE_REGISTER(coap_switch, LOG_LEVEL_INF);

static const struct gpio_dt_spec button = GPIO_DT_SPEC_GET(DT_ALIAS(sw0), gpios);
static const struct gpio_dt_spec led = GPIO_DT_SPEC_GET(DT_ALIAS(led0), gpios);

static struct gpio_callback button_cb_data;
static int64_t last_press_ms;

static void send_toggle_handler(struct k_work *work);
static void led_off_handler(struct k_work *work);

static K_WORK_DEFINE(send_work, send_toggle_handler);
static K_WORK_DELAYABLE_DEFINE(led_off_work, led_off_handler);

static void led_off_handler(struct k_work *work)
{
	ARG_UNUSED(work);
	gpio_pin_set_dt(&led, 0);
}

static otError coap_send_toggle(void)
{
	struct openthread_context *ctx = openthread_get_default_context();
	otMessage *msg = NULL;
	otMessageInfo info;
	otError err;

	openthread_api_mutex_lock(ctx);
	otInstance *inst = ctx->instance;

	do {
		if (otThreadGetDeviceRole(inst) < OT_DEVICE_ROLE_CHILD) {
			LOG_WRN("Thread 네트워크에 아직 붙지 않음 - 전송 생략 (ot state 확인)");
			err = OT_ERROR_INVALID_STATE;
			break;
		}

		msg = otCoapNewMessage(inst, NULL);
		if (msg == NULL) {
			err = OT_ERROR_NO_BUFS;
			break;
		}

		otCoapMessageInit(msg, OT_COAP_TYPE_NON_CONFIRMABLE, OT_COAP_CODE_PUT);
		otCoapMessageGenerateToken(msg, OT_COAP_DEFAULT_TOKEN_LENGTH);

		err = otCoapMessageAppendUriPathOptions(msg, CONFIG_LIGHT_SWITCH_COAP_URI);
		if (err != OT_ERROR_NONE) {
			break;
		}

		err = otCoapMessageSetPayloadMarker(msg);
		if (err != OT_ERROR_NONE) {
			break;
		}

		err = otMessageAppend(msg, "toggle", strlen("toggle"));
		if (err != OT_ERROR_NONE) {
			break;
		}

		memset(&info, 0, sizeof(info));
		info.mPeerPort = OT_DEFAULT_COAP_PORT;
		err = otIp6AddressFromString(CONFIG_LIGHT_SWITCH_PEER_ADDR, &info.mPeerAddr);
		if (err != OT_ERROR_NONE) {
			break;
		}

		err = otCoapSendRequest(inst, msg, &info, NULL, NULL);
	} while (0);

	if (err != OT_ERROR_NONE && msg != NULL) {
		otMessageFree(msg);
	}

	openthread_api_mutex_unlock(ctx);
	return err;
}

static void send_toggle_handler(struct k_work *work)
{
	ARG_UNUSED(work);

	gpio_pin_set_dt(&led, 1);
	k_work_schedule(&led_off_work, K_MSEC(150));

	otError err = coap_send_toggle();

	if (err == OT_ERROR_NONE) {
		LOG_INF("CoAP PUT coap://[%s]/%s \"toggle\" 전송",
			CONFIG_LIGHT_SWITCH_PEER_ADDR, CONFIG_LIGHT_SWITCH_COAP_URI);
	} else {
		LOG_ERR("CoAP 전송 실패: %d", err);
	}
}

static void button_pressed(const struct device *dev, struct gpio_callback *cb,
			   uint32_t pins)
{
	ARG_UNUSED(dev);
	ARG_UNUSED(cb);
	ARG_UNUSED(pins);

	int64_t now = k_uptime_get();

	if (now - last_press_ms < CONFIG_LIGHT_SWITCH_DEBOUNCE_MS) {
		return;
	}
	last_press_ms = now;

	k_work_submit(&send_work);
}

static int openthread_init(void)
{
	struct openthread_context *ctx = openthread_get_default_context();
	otError err;

	openthread_api_mutex_lock(ctx);
	otInstance *inst = ctx->instance;

	err = otCoapStart(inst, OT_DEFAULT_COAP_PORT);
	if (err != OT_ERROR_NONE) {
		openthread_api_mutex_unlock(ctx);
		LOG_ERR("otCoapStart 실패: %d", err);
		return -EIO;
	}

	/* 저장된 dataset이 있으면(이전에 조인한 적 있으면) 자동 재시작 */
	if (otDatasetIsCommissioned(inst)) {
		otIp6SetEnabled(inst, true);
		otThreadSetEnabled(inst, true);
		LOG_INF("저장된 Thread dataset 발견 - 네트워크 재시작");
	} else {
		LOG_INF("Thread dataset 없음. 셸에서 조인하세요:");
		LOG_INF("  ot dataset set active <OTBR의 dataset hex>");
		LOG_INF("  ot ifconfig up && ot thread start");
	}

	openthread_api_mutex_unlock(ctx);
	return 0;
}

int main(void)
{
	int ret;

	LOG_INF("=== Thing Plus Matter CoAP Light Switch ===");

	if (!gpio_is_ready_dt(&button) || !gpio_is_ready_dt(&led)) {
		LOG_ERR("GPIO 디바이스가 준비되지 않음");
		return -ENODEV;
	}

	gpio_pin_configure_dt(&led, GPIO_OUTPUT_INACTIVE);

	ret = gpio_pin_configure_dt(&button, GPIO_INPUT);
	if (ret != 0) {
		LOG_ERR("버튼 핀 설정 실패: %d", ret);
		return ret;
	}

	ret = gpio_pin_interrupt_configure_dt(&button, GPIO_INT_EDGE_TO_ACTIVE);
	if (ret != 0) {
		LOG_ERR("버튼 인터럽트 설정 실패: %d", ret);
		return ret;
	}

	gpio_init_callback(&button_cb_data, button_pressed, BIT(button.pin));
	gpio_add_callback(button.port, &button_cb_data);

	ret = openthread_init();
	if (ret != 0) {
		return ret;
	}

	LOG_INF("버튼(PB00)을 누르면 CoAP toggle을 전송합니다");
	return 0;
}
```
